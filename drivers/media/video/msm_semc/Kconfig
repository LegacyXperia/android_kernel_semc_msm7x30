## drivers/media/video/msm_semc/Kconfig
```kconfig
comment "Camera Sensor Selection"
config SEIX006
	bool "Sensor seix006"
	depends on MSM_CAMERA
	---help---
	  This is a camera driver for the seix006 sensor

config OVM7692
	bool "Sensor ovm7692"
	depends on MSM_CAMERA
	---help---
	  Omnivision VGA fixed focus sensor

config MT9V114
	bool "Sensor mt9v114"
	depends on MSM_CAMERA
	---help---
	  AAC/Heptagon VGA fixed focus sensor

config SEMC_CAMERA_MODULE
	bool "SEMC specific camera (Main camera)"
	depends on MSM_CAMERA
	---help---
	  SEMC specific camera module

config SEMC_SUB_CAMERA_MODULE
	bool "SEMC specific camera (Sub camera)"
	depends on MSM_CAMERA
	---help---
	  SEMC specific sub camera module

config MSM_CAMERA_FLASH
	bool "Qualcomm MSM camera flash support"
	depends on MSM_CAMERA
	default y
	---help---
	  Enable support for LED flash for msm camera

config MSM_GEMINI
	tristate "Qualcomm MSM Gemini Jpeg Engine support"
	depends on MSM_CAMERA && ARCH_MSM7X30
	default y
	---help---
	  Enable support for Gemini Jpeg Engine

config MSM_VPE
	tristate "Qualcomm MSM Video Pre-processing Engine support"
	depends on MSM_CAMERA && ARCH_MSM7X30
	default y
	---help---
	  Enable support for Video Pre-processing Engine

config MSM_VPE_STANDALONE
	tristate "Qualcomm MSM Video Pre-processing Engine support"
	depends on MSM_CAMERA && ARCH_MSM7X30
	default y
	---help---
	  Enable support for Video Pre-processing Engine

config QUP_EXCLUSIVE_TO_CAMERA
	bool "QUP exclusive to camera"
	depends on MSM_CAMERA
	default y
	---help---
	  This flag enabled states that QUP
	  is exclusive to camera. In case this
	  is disabled, the lvs1 voltage is enabled
	  by QUP in the board file as QUP is used by
	  applications other than camera.
```
